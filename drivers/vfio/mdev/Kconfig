## drivers/vfio/mdev/Kconfig
```kconfig
# SPDX-License-Identifier: GPL-2.0-only

config VFIO_MDEV
	tristate "Mediated device driver framework"
	depends on VFIO
	default n
	help
	  Provides a framework to virtualize devices.
	  See Documentation/driver-api/vfio-mediated-device.rst for more details.

	  If you don't know what do here, say N.

config VFIO_MDEV_DEVICE
	tristate "VFIO driver for Mediated devices"
	depends on VFIO && VFIO_MDEV
	default n
	help
	  VFIO based driver for Mediated devices.

config VFIO_MDEV_IDXD
	tristate "VFIO Mediated device driver for Intel IDXD"
	depends on VFIO && VFIO_MDEV
	select AUXILIARY_BUS
	default n
	help
	  VFIO based mediated device driver for Intel Accelerator Devices driver.
```
